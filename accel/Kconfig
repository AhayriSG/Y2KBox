## accel/Kconfig
```kconfig
config WHPX
    bool

config NVMM
    bool

config HVF
    bool

config TCG
    bool

config KVM
    bool

config MSHV
    bool

config NITRO
    bool
```

## hw/mem/Kconfig
```kconfig
config DIMM
    bool

config MEM_DEVICE
    bool

config NVDIMM
    bool

config SPARSE_MEM
    bool

config CXL_MEM_DEVICE
    bool
    default y if CXL

config SP_MEM
    bool
```
